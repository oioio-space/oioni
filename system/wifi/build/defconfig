## system/wifi/build/defconfig
```kconfig
CONFIG_DRIVER_NL80211=y
CONFIG_DRIVER_WEXT=y
CONFIG_WPS=y
CONFIG_EAP_PEAP=y
CONFIG_EAP_TTLS=y
CONFIG_EAP_TLS=y
CONFIG_EAP_MSCHAPV2=y
CONFIG_CTRL_IFACE=y
CONFIG_CTRL_IFACE_UNIX=y
CONFIG_BACKEND=file
CONFIG_IEEE8021X_EAPOL=y
CONFIG_CRYPTO=openssl
CONFIG_TLS=openssl
CONFIG_IPV6=y
```

## system/wifi/build/hostapd_defconfig
```kconfig
# hostapd build config — static ARM64, nl80211 only (BCM43430 on Pi Zero 2W)
CONFIG_DRIVER_NL80211=y
CONFIG_LIBNL32=y

CONFIG_IEEE80211W=y
CONFIG_WPA_SUPPLICANT=y
CONFIG_BACKEND=file

# Disable unneeded drivers to reduce binary size
CONFIG_DRIVER_HOSTAP=y
CONFIG_DRIVER_WIRED=y
CONFIG_DRIVER_NONE=y
```
